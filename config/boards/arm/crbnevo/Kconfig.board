## config/boards/arm/crbnevo/Kconfig.board
```kconfig
# CRBNEVO board configuration

# Copyright (c) 2021 Polarity Works
# SPDX-License-Identifier: MIT

config BOARD_CRBNEVO
	bool "crbnevo"
	depends on SOC_NRF52840_QIAA
```
